/* Copyright (c) 2013, The Linux Foundation. All rights reserved.
 *
 * This program is free software; you can redistribute it and/or modify
 * it under the terms of the GNU General Public License version 2 and
 * only version 2 as published by the Free Software Foundation.
 *
 * This program is distributed in the hope that it will be useful,
 * but WITHOUT ANY WARRANTY; without even the implied warranty of
 * MERCHANTABILITY or FITNESS FOR A PARTICULAR PURPOSE.  See the
 * GNU General Public License for more details.
 */

/*---------------------------------------------------------------------------
 * This file is autogenerated file using gcdb parser. Please do not edit it.
 * Update input XML file to add a new entry or update variable in this file
 * VERSION = "1.0"
 *---------------------------------------------------------------------------*/
&mdss_mdp {
	dsi_ili9881_tcl_720p_video: qcom,mdss_dsi_ili9881c_tcl_720p_video {
		qcom,mdss-dsi-panel-name = "ili9881c tcl 720p video mode dsi panel";
		qcom,mdss-dsi-panel-controller = <&mdss_dsi0>;
		qcom,mdss-dsi-panel-type = "dsi_video_mode";
		qcom,mdss-dsi-panel-destination = "display_1";
		qcom,mdss-dsi-panel-framerate = <60>;
		qcom,mdss-dsi-virtual-channel-id = <0>;
		qcom,mdss-dsi-stream = <0>;
		qcom,mdss-dsi-panel-width = <720>;
		qcom,mdss-dsi-panel-height = <1280>;
		qcom,mdss-dsi-h-front-porch = <128>;
		qcom,mdss-dsi-h-back-porch = <160>;
		qcom,mdss-dsi-h-pulse-width = <8>;
		qcom,mdss-dsi-h-sync-skew = <0>;
		qcom,mdss-dsi-v-back-porch = <8>;
		qcom,mdss-dsi-v-front-porch = <20>;
		qcom,mdss-dsi-v-pulse-width = <8>;
		qcom,mdss-dsi-h-left-border = <0>;
		qcom,mdss-dsi-h-right-border = <0>;
		qcom,mdss-dsi-v-top-border = <0>;
		qcom,mdss-dsi-v-bottom-border = <0>;
		qcom,mdss-dsi-bpp = <24>;
		qcom,mdss-dsi-color-order = "rgb_swap_rgb";
		qcom,mdss-dsi-underflow-color = <0xff>;
		qcom,mdss-dsi-border-color = <0>;
		qcom,mdss-dsi-on-command = [39 01 00 00 00 00 04 FF 98 81 03
                                15 01 00 00 00 00 02 01 00
                                15 01 00 00 00 00 02 02 00
                                15 01 00 00 00 00 02 03 73
                                15 01 00 00 00 00 02 04 03
                                15 01 00 00 00 00 02 05 00
                                15 01 00 00 00 00 02 06 06
                                15 01 00 00 00 00 02 07 06
                                15 01 00 00 00 00 02 08 00
                                15 01 00 00 00 00 02 09 18
                                15 01 00 00 00 00 02 0a 04
                                15 01 00 00 00 00 02 0b 00
                                15 01 00 00 00 00 02 0c 02
                                15 01 00 00 00 00 02 0d 03
                                15 01 00 00 00 00 02 0e 00
                                15 01 00 00 00 00 02 0f 25
                                15 01 00 00 00 00 02 10 25
                                15 01 00 00 00 00 02 11 00
                                15 01 00 00 00 00 02 12 00
                                15 01 00 00 00 00 02 13 00
                                15 01 00 00 00 00 02 14 00
                                15 01 00 00 00 00 02 15 00
                                15 01 00 00 00 00 02 16 0C
                                15 01 00 00 00 00 02 17 00
                                15 01 00 00 00 00 02 18 00
                                15 01 00 00 00 00 02 19 00
                                15 01 00 00 00 00 02 1a 00
                                15 01 00 00 00 00 02 1b 00
                                15 01 00 00 00 00 02 1c 00
                                15 01 00 00 00 00 02 1d 00
                                15 01 00 00 00 00 02 1e C0
                                15 01 00 00 00 00 02 1f 80
                                15 01 00 00 00 00 02 20 04
                                15 01 00 00 00 00 02 21 01
                                15 01 00 00 00 00 02 22 00
                                15 01 00 00 00 00 02 23 00
                                15 01 00 00 00 00 02 24 00
                                15 01 00 00 00 00 02 25 00
                                15 01 00 00 00 00 02 26 00
                                15 01 00 00 00 00 02 27 00
                                15 01 00 00 00 00 02 28 33
                                15 01 00 00 00 00 02 29 03
                                15 01 00 00 00 00 02 2a 00
                                15 01 00 00 00 00 02 2b 00
                                15 01 00 00 00 00 02 2c 00
                                15 01 00 00 00 00 02 2d 00
                                15 01 00 00 00 00 02 2e 00
                                15 01 00 00 00 00 02 2f 00
                                15 01 00 00 00 00 02 30 00
                                15 01 00 00 00 00 02 31 00
                                15 01 00 00 00 00 02 32 00
                                15 01 00 00 00 00 02 33 00
                                15 01 00 00 00 00 02 34 04
                                15 01 00 00 00 00 02 35 00
                                15 01 00 00 00 00 02 36 00
                                15 01 00 00 00 00 02 37 00
                                15 01 00 00 00 00 02 38 3C
                                15 01 00 00 00 00 02 39 00
                                15 01 00 00 00 00 02 3a 00
                                15 01 00 00 00 00 02 3b 00
                                15 01 00 00 00 00 02 3c 00
                                15 01 00 00 00 00 02 3d 00
                                15 01 00 00 00 00 02 3e 00
                                15 01 00 00 00 00 02 3f 00
                                15 01 00 00 00 00 02 40 00
                                15 01 00 00 00 00 02 41 00
                                15 01 00 00 00 00 02 42 00
                                15 01 00 00 00 00 02 43 00
                                15 01 00 00 00 00 02 44 00
                                15 01 00 00 00 00 02 50 01
                                15 01 00 00 00 00 02 51 23
                                15 01 00 00 00 00 02 52 45
                                15 01 00 00 00 00 02 53 67
                                15 01 00 00 00 00 02 54 89
                                15 01 00 00 00 00 02 55 ab
                                15 01 00 00 00 00 02 56 01
                                15 01 00 00 00 00 02 57 23
                                15 01 00 00 00 00 02 58 45
                                15 01 00 00 00 00 02 59 67
                                15 01 00 00 00 00 02 5a 89
                                15 01 00 00 00 00 02 5b ab
                                15 01 00 00 00 00 02 5c cd
                                15 01 00 00 00 00 02 5d ef
                                15 01 00 00 00 00 02 5e 11
                                15 01 00 00 00 00 02 5f 02
                                15 01 00 00 00 00 02 60 02
                                15 01 00 00 00 00 02 61 02
                                15 01 00 00 00 00 02 62 02
                                15 01 00 00 00 00 02 63 02
                                15 01 00 00 00 00 02 64 02
                                15 01 00 00 00 00 02 65 02
                                15 01 00 00 00 00 02 66 02
                                15 01 00 00 00 00 02 67 02
                                15 01 00 00 00 00 02 68 02
                                15 01 00 00 00 00 02 69 02
                                15 01 00 00 00 00 02 6a 0C
                                15 01 00 00 00 00 02 6b 02
                                15 01 00 00 00 00 02 6c 0F
                                15 01 00 00 00 00 02 6d 0E
                                15 01 00 00 00 00 02 6e 0D
                                15 01 00 00 00 00 02 6f 06
                                15 01 00 00 00 00 02 70 07
                                15 01 00 00 00 00 02 71 02
                                15 01 00 00 00 00 02 72 02
                                15 01 00 00 00 00 02 73 02
                                15 01 00 00 00 00 02 74 02
                                15 01 00 00 00 00 02 75 02
                                15 01 00 00 00 00 02 76 02
                                15 01 00 00 00 00 02 77 02
                                15 01 00 00 00 00 02 78 02
                                15 01 00 00 00 00 02 79 02
                                15 01 00 00 00 00 02 7a 02
                                15 01 00 00 00 00 02 7b 02
                                15 01 00 00 00 00 02 7c 02
                                15 01 00 00 00 00 02 7d 02
                                15 01 00 00 00 00 02 7e 02
                                15 01 00 00 00 00 02 7f 02
                                15 01 00 00 00 00 02 80 0C
                                15 01 00 00 00 00 02 81 02
                                15 01 00 00 00 00 02 82 0F
                                15 01 00 00 00 00 02 83 0E
                                15 01 00 00 00 00 02 84 0D
                                15 01 00 00 00 00 02 85 06
                                15 01 00 00 00 00 02 86 07
                                15 01 00 00 00 00 02 87 02
                                15 01 00 00 00 00 02 88 02
                                15 01 00 00 00 00 02 89 02
                                15 01 00 00 00 00 02 8A 02
                                39 01 00 00 00 00 04 FF 98 81 04
                                15 01 00 00 00 00 02 6C 15
                                15 01 00 00 00 00 02 6E 22
                                15 01 00 00 00 00 02 6F 33
                                15 01 00 00 00 00 02 3A A4
                                15 01 00 00 00 00 02 8D 0d
                                15 01 00 00 00 00 02 87 BA
                                15 01 00 00 00 00 02 26 76
                                15 01 00 00 00 00 02 B2 D1
                                39 01 00 00 00 00 04 FF 98 81 01
                                15 01 00 00 00 00 02 22 0A
                                15 01 00 00 00 00 02 53 c7
                                15 01 00 00 00 00 02 55 A7
                                15 01 00 00 00 00 02 50 74
                                15 01 00 00 00 00 02 51 74
                                15 01 00 00 00 00 02 31 00
                                15 01 00 00 00 00 02 60 14
                                15 01 00 00 00 00 02 A0 15
                                15 01 00 00 00 00 02 A1 38
                                15 01 00 00 00 00 02 A2 44
                                15 01 00 00 00 00 02 A3 15
                                15 01 00 00 00 00 02 A4 17
                                15 01 00 00 00 00 02 A5 2a
                                15 01 00 00 00 00 02 A6 1E
                                15 01 00 00 00 00 02 A7 1f
                                15 01 00 00 00 00 02 A8 9a
                                15 01 00 00 00 00 02 A9 1a
                                15 01 00 00 00 00 02 AA 28
                                15 01 00 00 00 00 02 AB 80
                                15 01 00 00 00 00 02 AC 23
                                15 01 00 00 00 00 02 AD 1e
                                15 01 00 00 00 00 02 AE 52
                                15 01 00 00 00 00 02 AF 22
                                15 01 00 00 00 00 02 B0 27
                                15 01 00 00 00 00 02 B1 4d
                                15 01 00 00 00 00 02 B2 5b
                                15 01 00 00 00 00 02 B3 3F
                                15 01 00 00 00 00 02 C0 05
                                15 01 00 00 00 00 02 C1 18
                                15 01 00 00 00 00 02 C2 28
                                15 01 00 00 00 00 02 C3 15
                                15 01 00 00 00 00 02 C4 17
                                15 01 00 00 00 00 02 C5 2a
                                15 01 00 00 00 00 02 C6 1E
                                15 01 00 00 00 00 02 C7 1f
                                15 01 00 00 00 00 02 C8 96
                                15 01 00 00 00 00 02 C9 1a
                                15 01 00 00 00 00 02 CA 28
                                15 01 00 00 00 00 02 CB 80
                                15 01 00 00 00 00 02 CC 13
                                15 01 00 00 00 00 02 CD 16
                                15 01 00 00 00 00 02 CE 4c
                                15 01 00 00 00 00 02 CF 22
                                15 01 00 00 00 00 02 D0 27
                                15 01 00 00 00 00 02 D1 4d
                                15 01 00 00 00 00 02 D2 5b
                                15 01 00 00 00 00 02 D3 3F
                                39 01 00 00 00 00 04 FF 98 81 02
                                15 01 00 00 00 00 02 19 E0               //sre
                                15 01 00 00 00 00 02 80 10               //sre
                                15 01 00 00 00 00 02 81 25              //sre
                                15 01 00 00 00 00 02 82 20             //sre
                                39 01 00 00 00 00 04 FF 98 81 00
                                15 01 00 00 00 00 02 35 00
                                05 01 00 00 96 00 02 11 00
                                05 01 00 00 1e 00 02 29 00];
		qcom,mdss-dsi-off-command = [29 01 00 00 14 00 02 28 00
					29 01 00 00 78 00 02 10 00];
		qcom,mdss-dsi-on-command-state = "dsi_lp_mode";
		qcom,mdss-dsi-off-command-state = "dsi_lp_mode";
                //Begin <JABALL-1500><20150623>Add sun panel function for L5510;xiongdajun
             qcom,mdss-dsi-panel-aiehi-command = [39 01 00 00 00 00 04 FF 98 81 00
                                15 01 00 00 00 00 02 55 40];
		qcom,mdss-dsi-panel-aiehi-command-state = "dsi_hs_mode";
             qcom,mdss-dsi-panel-aielow-command = [39 01 00 00 00 00 04 FF 98 81 00
                                15 01 00 00 00 00 02 55 40];
		qcom,mdss-dsi-panel-aielow-command-state = "dsi_hs_mode";
             qcom,mdss-dsi-panel-aieoff-command = [39 01 00 00 00 00 04 FF 98 81 00
                                15 01 00 00 00 00 02 55 00];
		qcom,mdss-dsi-panel-aieoff-command-state = "dsi_hs_mode";
         //END <JABALL-1500><20150623>Add sun panel function for L5510;xiongdajn
		//<BEGIN><><20141025><modify for ESD>xiongdajun
		qcom,mdss-dsi-panel-status-command = [06 01 00 01 05 00 02 ac 08];
		qcom,mdss-dsi-panel-status-command-state = "dsi_hs_mode";
		qcom,mdss-dsi-panel-status-check-mode = "reg_read";
		qcom,mdss-dsi-panel-status-value = <0x00>;
		//qcom,mdss-dsi-panel-status-check-mode = "bta_check";
		//<END><><20141025><modify for ESD>xiongdajun
                qcom,esd-check-enabled;
		qcom,mdss-dsi-h-sync-pulse = <1>;
		qcom,mdss-dsi-traffic-mode = "burst_mode";
		qcom,mdss-dsi-lane-map = "lane_map_0123";
		qcom,mdss-dsi-bllp-eof-power-mode;
		qcom,mdss-dsi-bllp-power-mode;
		qcom,mdss-dsi-lane-0-state;
		qcom,mdss-dsi-lane-1-state;
		qcom,mdss-dsi-lane-2-state;
		qcom,mdss-dsi-lane-3-state;
		qcom,mdss-dsi-panel-timings = [75 18 10 00 3A 3E 14 1A 13 03 04 00];
		qcom,mdss-dsi-t-clk-post = <0x2c>;
		qcom,mdss-dsi-t-clk-pre = <0x20>;
		qcom,mdss-dsi-bl-min-level = <1>;
		qcom,mdss-dsi-bl-max-level = <255>;
		qcom,mdss-dsi-dma-trigger = "trigger_sw";
		qcom,mdss-dsi-mdp-trigger = "none";
		qcom,mdss-dsi-bl-pmic-control-type = "bl_ctrl_pwm";
                //qcom,mdss-dsi-bl-pmic-control-type = "bl_ctrl_gp_clk";//add by YangRujin for gp_clk control bl.
		qcom,mdss-dsi-bl-pmic-pwm-frequency = <30>; // 10KHz to 37.5KHz //wangyanhui
		qcom,mdss-dsi-bl-pmic-bank-select = <0>;
		qcom,mdss-dsi-pwm-gpio = <&pm8916_mpps 4 0>;
		//qcom,mdss-dsi-reset-sequence = <1 1>, <0 50>, <1 50>;
             qcom,mdss-dsi-lp11-init;
                //qcom,mdss-dsi-init-delay-us = <100>;
                qcom,mdss-dsi-reset-sequence = <1 20>, <0 20>, <1 50>;
                //qcom,mdss-dsi-hfp-power-mode;
                //qcom,mdss-dsi-hbp-power-mode;
                //qcom,mdss-dsi-hsa-power-mode;

	};
};

