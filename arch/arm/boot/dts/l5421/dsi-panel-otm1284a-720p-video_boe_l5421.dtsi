/* Copyright (c) 2013, The Linux Foundation. All rights reserved.
 *
 * This program is free software; you can redistribute it and/or modify
 * it under the terms of the GNU General Public License version 2 and
 * only version 2 as published by the Free Software Foundation.
 *
 * This program is distributed in the hope that it will be useful,
 * but WITHOUT ANY WARRANTY; without even the implied warranty of
 * MERCHANTABILITY or FITNESS FOR A PARTICULAR PURPOSE.  See the
 * GNU General Public License for more details.
 */

/*---------------------------------------------------------------------------
 * This file is autogenerated file using gcdb parser. Please do not edit it.
 * Update input XML file to add a new entry or update variable in this file
 * VERSION = "1.0"
 *---------------------------------------------------------------------------*/
&mdss_mdp {
	dsi_otm1284a_720p_video: qcom,mdss_dsi_otm1284a_720p_video {
		qcom,mdss-dsi-panel-name = "otm1284a 720p video mode dsi panel";
		qcom,mdss-dsi-panel-controller = <&mdss_dsi0>;
		qcom,mdss-dsi-panel-type = "dsi_video_mode";
		qcom,mdss-dsi-panel-destination = "display_1";
		qcom,mdss-dsi-panel-framerate = <60>;
		qcom,mdss-dsi-virtual-channel-id = <0>;
		qcom,mdss-dsi-stream = <0>;
		qcom,mdss-dsi-panel-width = <720>;
		qcom,mdss-dsi-panel-height = <1280>;
		qcom,mdss-dsi-h-front-porch = <80>;
		qcom,mdss-dsi-h-back-porch = <78>;
		qcom,mdss-dsi-h-pulse-width = <2>;
		qcom,mdss-dsi-h-sync-skew = <0>;
		qcom,mdss-dsi-v-back-porch = <14>;
		qcom,mdss-dsi-v-front-porch = <16>;
		qcom,mdss-dsi-v-pulse-width = <2>;
		qcom,mdss-dsi-h-left-border = <0>;
		qcom,mdss-dsi-h-right-border = <0>;
		qcom,mdss-dsi-v-top-border = <0>;
		qcom,mdss-dsi-v-bottom-border = <0>;
		qcom,mdss-dsi-bpp = <24>;
		qcom,mdss-dsi-color-order = "rgb_swap_rgb";
		qcom,mdss-dsi-underflow-color = <0xff>;
		qcom,mdss-dsi-border-color = <0>;
		qcom,mdss-dsi-on-command = [39 01 00 00 00 00 04 FF 12 84 01
                        15 01 00 00 00 00 02 00 80
                        39 01 00 00 00 00 03 FF 12 84
                        15 01 00 00 00 00 02 00 91
                        15 01 00 00 00 00 02 B0 9A
                        15 01 00 00 00 00 02 00 92
                        39 01 00 00 00 00 03 FF 30 02
                        15 01 00 00 00 00 02 00 80
                        39 01 00 00 00 00 0A C0 00 64 00 0F 11 00 64 0F 11
                        15 01 00 00 00 00 02 00 90
                        39 01 00 00 00 00 07 C0 00 5F 00 01 00 04
                        15 01 00 00 00 00 02 00 A4
                        15 01 00 00 00 00 02 C0 00
                        15 01 00 00 00 00 02 00 B3
                        39 01 00 00 00 00 03 C0 00 50
                        15 01 00 00 00 00 02 00 81
                        15 01 00 00 00 00 02 C1 55
                        15 01 00 00 00 00 02 00 90
                        39 01 00 00 00 00 05 F5 02 11 02 15
                        15 01 00 00 00 00 02 00 90
                        15 01 00 00 00 00 02 C5 50
                        15 01 00 00 00 00 02 00 94
                        15 01 00 00 00 00 02 C5 66
                        15 01 00 00 00 00 02 00 B2
                        39 01 00 00 00 00 03 F5 00 00
                        15 01 00 00 00 00 02 00 B4
                        39 01 00 00 00 00 03 F5 00 00
                        15 01 00 00 00 00 02 00 B6
                        39 01 00 00 00 00 03 F5 00 00
                        15 01 00 00 00 00 02 00 B8
                        39 01 00 00 00 00 03 F5 00 00
                        15 01 00 00 00 00 02 00 B4
                        15 01 00 00 00 00 02 C5 CC
                        15 01 00 00 00 00 02 00 A0
                        39 01 00 00 00 00 0F C4 05 10 06 02 05 15 10 05 10 07 02 05 15 10
                        15 01 00 00 00 00 02 00 B0
                        39 01 00 00 00 00 03 C4 00 00
                        15 01 00 00 00 00 02 00 91
                        39 01 00 00 00 00 03 C5 19 52
                        15 01 00 00 00 00 02 00 00
                        39 01 00 00 00 00 03 D8 C6 C6
                        15 01 00 00 00 00 02 00 B3
                        15 01 00 00 00 00 02 C5 84
                        15 01 00 00 00 00 02 00 BB
                        15 01 00 00 00 00 02 C5 8A
                        15 01 00 00 00 00 02 00 B2
                        15 01 00 00 00 00 02 C5 40
                        15 01 00 00 00 00 02 00 81
                        39 01 00 00 00 00 03 C4 86 0A
                        15 01 00 00 00 00 02 00 88
                        15 01 00 00 00 00 02 C4 80
                        15 01 00 00 00 00 02 00 C6
                        15 01 00 00 00 00 02 B0 03
                        15 01 00 00 00 00 02 00 B1
                        15 01 00 00 00 00 02 C6 02
                        15 01 00 00 00 00 02 00 B4
                        15 01 00 00 00 00 02 C6 10
                        15 01 00 00 00 00 02 00 00
                        39 01 00 00 00 00 15 E1 00 14 20 2d 3b 49 4a 73 62 7b 88 74 86 60 5b 4b 39 26 15 00
                        15 01 00 00 00 00 02 00 00
                        39 01 00 00 00 00 15 E2 00 14 20 2d 3b 49 4a 73 62 7b 88 74 86 60 5b 4b 39 26 15 00
                        15 01 00 00 00 00 02 00 80
                        39 01 00 00 00 00 0C CB 00 00 00 00 00 00 00 00 00 00 00
                        15 01 00 00 00 00 02 00 90
                        39 01 00 00 00 00 10 CB 00 00 00 00 00 00 00 00 00 00 00 00 00 00 00
                        15 01 00 00 00 00 02 00 A0
                        39 01 00 00 00 00 10 CB 00 00 00 00 00 00 00 00 00 00 00 00 00 00 00
                        15 01 00 00 00 00 02 00 B0
                        39 01 00 00 00 00 10 CB 00 00 00 00 00 00 00 00 00 00 00 00 00 00 00
                        15 01 00 00 00 00 02 00 C0
                        39 01 00 00 00 00 10 CB 05 05 05 05 05 05 05 05 05 00 00 00 00 00 00
                        15 01 00 00 00 00 02 00 D0
                        39 01 00 00 00 00 10 CB 00 00 00 05 05 05 05 05 05 05 05 05 05 05 05
                        15 01 00 00 00 00 02 00 E0
                        39 01 00 00 00 00 0F CB 05 00 00 00 00 00 00 00 00 00 05 05 05 05
                        15 01 00 00 00 00 02 00 F0
                        39 01 00 00 00 00 0C CB FF FF FF FF FF FF FF FF FF FF FF
                        15 01 00 00 00 00 02 00 80
                        39 01 00 00 00 00 10 CC 2D 2D 0A 0C 0E 10 00 00 00 00 00 00 00 00 00
                        15 01 00 00 00 00 02 00 90
                        39 01 00 00 00 00 10 CC 00 00 00 2E 2E 02 04 2D 2D 09 0B 0D 0F 00 00
                        15 01 00 00 00 00 02 00 A0
                        39 01 00 00 00 00 0F CC 00 00 00 00 00 00 00 00 00 00 2E 2E 01 03
                        15 01 00 00 00 00 02 00 B0
                        39 01 00 00 00 00 10 CC 2D 2E 0F 0D 0B 09 00 00 00 00 00 00 00 00 00
                        15 01 00 00 00 00 02 00 C0
                        39 01 00 00 00 00 10 CC 00 00 00 2E 2D 03 01 2D 2E 10 0E 0C 0A 00 00
                        15 01 00 00 00 00 02 00 D0
                        39 01 00 00 00 00 0F CC 00 00 00 00 00 00 00 00 00 00 2E 2D 04 02
                        15 01 00 00 00 00 02 00 80
                        39 01 00 00 00 00 0D CE 8D 03 29 8C 03 29 8B 03 29 8A 03 29
                        15 01 00 00 00 00 02 00 90
                        39 01 00 00 00 00 0F CE 00 00 00 00 00 00 00 00 00 00 00 00 00 00
                        15 01 00 00 00 00 02 00 A0
                        39 01 00 00 00 00 0F CE 38 0B 8B 00 8D 29 00 38 0A 8B 01 8D 29 00
                        15 01 00 00 00 00 02 00 B0
                        39 01 00 00 00 00 0F CE 38 09 8B 02 8D 29 00 38 08 8B 03 8D 29 00
                        15 01 00 00 00 00 02 00 C0
                        39 01 00 00 00 00 0F CE 38 07 8B 04 8D 29 00 38 06 8B 05 8D 29 00
                        15 01 00 00 00 00 02 00 D0
                        39 01 00 00 00 00 0F CE 38 05 8B 06 8D 29 00 38 04 8B 07 8D 29 00
                        15 01 00 00 00 00 02 00 80
                        39 01 00 00 00 00 0F CF 00 00 00 00 00 00 00 00 00 00 00 00 00 00
                        15 01 00 00 00 00 02 00 90
                        39 01 00 00 00 00 0F CF 00 00 00 00 00 00 00 00 00 00 00 00 00 00
                        15 01 00 00 00 00 02 00 A0
                        39 01 00 00 00 00 0F CF 00 00 00 00 00 00 00 00 00 00 00 00 00 00
                        15 01 00 00 00 00 02 00 B0
                        39 01 00 00 00 00 0F CF 00 00 00 00 00 00 00 00 00 00 00 00 00 00
                        15 01 00 00 00 00 02 00 C0
                        39 01 00 00 00 00 0C CF 01 01 20 20 00 00 01 01 00 00 00
                        15 01 00 00 00 00 02 00 B5
                        39 01 00 00 00 00 07 C5 3C 01 FF 3C 01 FF
                        15 01 00 00 00 00 02 00 A0
                        39 01 00 00 00 00 0D D6 01 0D 01 0D 01 A6 01 A6 01 A6 01 A6
                        15 01 00 00 00 00 02 00 B0
                        39 01 00 00 00 00 0D D6 01 A6 01 A6 01 A6 01 A6 01 A6 01 A6
                        15 01 00 00 00 00 02 00 C0
                        39 01 00 00 00 00 0D D6 55 11 09 6F 11 6F 6F 11 6F 6F 11 6F
                        15 01 00 00 00 00 02 00 D0
                        39 01 00 00 00 00 07 D6 6F 11 6F 6F 11 6F
                        15 01 00 00 00 00 02 00 E0
                        39 01 00 00 00 00 0D D6 2B 11 37 37 11 37 37 11 37 37 11 37
                        15 01 00 00 00 00 02 00 F0
                        39 01 00 00 00 00 07 D6 37 11 37 37 11 37
                        15 01 00 00 00 00 02 81 00
                        15 01 00 00 00 00 02 00 88
                        15 01 00 00 00 00 02 c4 80
                        15 01 00 00 00 00 02 00 90
                        15 01 00 00 00 00 02 b0 00
                        15 01 00 00 00 00 02 00 92
                        15 01 00 00 00 00 02 b3 06
                        15 01 00 00 00 00 02 00 90
                        15 01 00 00 00 00 02 f6 00
                        15 01 00 00 00 00 02 00 b2
                        15 01 00 00 00 00 02 c4 81
                        15 01 00 00 00 00 02 00 b5
                        15 01 00 00 00 00 02 c4 80
                        15 01 00 00 00 00 02 00 93
                        15 01 00 00 00 00 02 c1 90
                        15 01 00 00 00 00 02 00 A0
                        15 01 00 00 00 00 02 C1 02
                        15 01 00 00 00 00 02 00 A2
                        15 01 00 00 00 00 02 C1 08
                        15 01 00 00 00 00 02 00 A4
                        15 01 00 00 00 00 02 C1 f0
                        //Begin <REQ><JABALL-1500><20150619>;xiongdajun
            15 01 00 00 00 00 02 00 00
             39 01 00 00 00 00 04 ff 12 84 01
             15 01 00 00 00 00 02 00 80
             39 01 00 00 00 00 03 ff 12 84

            15 01 00 00 00 00 02 00 01
            39 01 00 00 00 00 02 c6 10
            15 01 00 00 00 00 02 00 00
            39 01 00 00 00 00 13 C8 82 78 56 34 33 33 33 33 33 33 33 44 44 44 44 44 44 44

           15 01 00 00 00 00 02 00 01
           15 01 00 00 00 00 02 c6 11
           15 01 00 00 00 00 02 00 00
           39 01 00 00 00 00 13 C8 B4 7A 57 33 33 33 33 33 33 33 33 33 33 33 44 44 44 44
           
           15 01 00 00 00 00 02 00 01
           15 01 00 00 00 00 02 c6 12
           15 01 00 00 00 00 02 00 00
           39 01 00 00 00 00 13 C8 C6 AC 58 33 33 33 33 33 33 33 33 33 33 33 33 33 33 33

           15 01 00 00 00 00 02 00 01
           15 01 00 00 00 00 02 c6 00

//END <REQ><JABALL-1500><20150619>;xiongdajun  
                        15 01 00 00 00 00 02 00 00
                        39 01 00 00 00 00 04 FF FF FF FF
                        15 01 00 00 00 00 02 00 00
                        15 01 00 00 00 00 02 36 00
                        15 01 00 00 00 00 02 00 00
                        15 01 00 00 00 00 02 35 00
                        15 01 00 00 96 00 02 11 00
                        15 01 00 00 1e 00 02 29 00];
		qcom,mdss-dsi-off-command = [29 01 00 00 14 00 02 28 00
					29 01 00 00 78 00 02 10 00];
		qcom,mdss-dsi-on-command-state = "dsi_lp_mode";
		qcom,mdss-dsi-off-command-state = "dsi_lp_mode";
        //Begin <JABALL-1500><20150623>Add sun panel function for L5510;xiongdajun
             qcom,mdss-dsi-panel-aiehi-command = [15 01 00 00 00 00 02 00 00
                                   15 01 00 00 00 00 02 82 82];
		qcom,mdss-dsi-panel-aiehi-command-state = "dsi_hs_mode";
             qcom,mdss-dsi-panel-aielow-command = [15 01 00 00 00 00 02 00 00
                                   15 01 00 00 00 00 02 82 82];
		qcom,mdss-dsi-panel-aielow-command-state = "dsi_hs_mode";
             qcom,mdss-dsi-panel-aieoff-command = [15 01 00 00 00 00 02 00 00
                                   15 01 00 00 00 00 02 82 00];
		qcom,mdss-dsi-panel-aieoff-command-state = "dsi_hs_mode";
         //END <JABALL-1500><20150623>Add sun panel function for L5510;xiongdajn
		//<BEGIN><><20141025><modify for ESD>xiongdajun
		qcom,mdss-dsi-panel-status-command = [06 01 00 01 05 00 02 ac 08];
		qcom,mdss-dsi-panel-status-command-state = "dsi_hs_mode";
		qcom,mdss-dsi-panel-status-check-mode = "reg_read";
		qcom,mdss-dsi-panel-status-value = <0x00>;
		//qcom,mdss-dsi-panel-status-check-mode = "bta_check";
		//<END><><20141025><modify for ESD>xiongdajun
                qcom,esd-check-enabled;
		qcom,mdss-dsi-h-sync-pulse = <1>;
		qcom,mdss-dsi-traffic-mode = "burst_mode";
		qcom,mdss-dsi-lane-map = "lane_map_0123";
		qcom,mdss-dsi-bllp-eof-power-mode;
		qcom,mdss-dsi-bllp-power-mode;
		qcom,mdss-dsi-lane-0-state;
		qcom,mdss-dsi-lane-1-state;
		qcom,mdss-dsi-lane-2-state;
		qcom,mdss-dsi-lane-3-state;
		qcom,mdss-dsi-panel-timings = [75 18 10 00 3A 3E 14 1A 13 03 04 00];
		qcom,mdss-dsi-t-clk-post = <0x2c>;
		qcom,mdss-dsi-t-clk-pre = <0x20>;
		qcom,mdss-dsi-bl-min-level = <1>;
		qcom,mdss-dsi-bl-max-level = <255>;
		qcom,mdss-dsi-dma-trigger = "trigger_sw";
		qcom,mdss-dsi-mdp-trigger = "none";
		qcom,mdss-dsi-bl-pmic-control-type = "bl_ctrl_pwm";
                //qcom,mdss-dsi-bl-pmic-control-type = "bl_ctrl_gp_clk";//add by YangRujin for gp_clk control bl.
		qcom,mdss-dsi-bl-pmic-pwm-frequency = <30>; // 10KHz to 37.5KHz //wangyanhui
		qcom,mdss-dsi-bl-pmic-bank-select = <0>;
		qcom,mdss-dsi-pwm-gpio = <&pm8916_mpps 4 0>;
		//qcom,mdss-dsi-reset-sequence = <1 1>, <0 50>, <1 50>;
             qcom,mdss-dsi-lp11-init;
                //qcom,mdss-dsi-init-delay-us = <100>;
                qcom,mdss-dsi-reset-sequence = <1 20>, <0 20>, <1 50>;
                //qcom,mdss-dsi-hfp-power-mode;
                //qcom,mdss-dsi-hbp-power-mode;
                //qcom,mdss-dsi-hsa-power-mode;

	};
};
